OUTPUT_ARCH(riscv)
ENTRY(_start)

SECTIONS
{
    . = 0x10000; /* User load address */

    .text : {
        *(.text.entry)
        *(.text .text.*)
    }

    .rodata : {
        *(.rodata .rodata.*)
    }

    .data : {
        *(.data .data.*)
    }

    .bss : {
        *(.bss .bss.*)
        *(COMMON)
    }
}
